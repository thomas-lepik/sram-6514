/* 
 *  HM-6514/883 is a 1024 x 4 static CMOS RAM  (64x64 matrix = 4096 bit) mod 9. 
 *  2 ^4 = 16; 2 ^6 = 64; 16 x 64 = 1024 cells containing 4 bit data
 *  
 *  AVR328 @ 16MHz (5V) --> 1 cycle = 62.5 ns
 *  
 *  https://www.arduino.cc/en/Reference/PortManipulation
 *  http://playground.arduino.cc/Code/BitMath
 *  
 *  http://www.kernelcrash.com/blog/using-an-arduino-to-read-write-a-static-ram/2016/01/04/
 *  https://github.com/ennui2342/arduino-sram
 *  
 *  SRAM tutorial
 *  http://www.eeherald.com/section/design-guide/esmod15.html
 *  https://learn.sparkfun.com/blog/1687  speed test
 *  https://learn.adafruit.com/memories-of-an-arduino/optimizing-sram  -- memory types
 *  
 *  The memory device that has 10 address lines will be having its address pins labeled
 *  from A0 (Least Significant) to A9. 
 *  
 *  Üheksane grupp
 *  A0 – Must            pd2   d2    // portd 
 *  A1 – Valge           pd3   d3
 *  A2 – hall            pd4   d4
 *  A3 – lilla           pd5   d5
 *  A4 – sinine          pd6   d6
 *  A5 – roheline        pd7   d7 
 *  
 *  A6 – kollane         pb0   d8    // portb
 *  A7 – oranž           pb1   d9
 *  A8 – punane          pb2   d10   
 *  A9 – pruun           pb3   d11   
 *  
 *  Kahene grupp
 *  E – valge            pb4   d12  SI
 *  W – must             pb5   d13  SC
 *  
 *  Data gupp
 *  DQ0 – pruun          pc0   d14  a0
 *  DQ1 – punane         pc1   d15  a1
 *  DQ2 – oranž          pc2   d16  a2
 *  DQ3 – kollane        pc3   d17  a3
*/

#define TAVEL    20    // Address Setup Time
#define TEHEL    120   // Chip Enable Pulse Positive Width
#define TELAX    50    // Address Hold Time
#define TELQV    5     // Chip Enable Access Time
#define TDVWH    200   // Data Setup Time 
#define TWLEL    10    // Early output High-Z time
 
#define DBG

#define BUTTON_PIN   18 

bool oldState = HIGH;

uint8_t z = 0;

uint8_t s[][64]={
{0x0,0x0,0x0,0x0,0x0,0x0,0x0,0x0,0x0,0x0,0x0,0x0,0x0,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0x0,0x0},
{0x0,0x0,0x0,0x0,0x0,0x0,0x0,0x0,0x0,0x0,0x0,0x0,0x0,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0x0,0x0},
{0x0,0x0,0x0,0x0,0x0,0x0,0x0,0x0,0x0,0x0,0x0,0x0,0x0,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0x0,0x0},
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{0x0,0x0,0x0,0x0,0x0,0x0,0x0,0x0,0x0,0x0,0x0,0x0,0x0,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0x0,0x0}
};



void setup() {
  
#ifdef DBG
  Serial.begin(115200);
#endif

  pinMode(BUTTON_PIN, INPUT_PULLUP);

  DDRC  = B00110000;  // data bits: 0 = input; 1 = output;
  DDRD  = B11111100;  // Grupp A  PD0..PD1: Rx/Tx
  DDRB  = B00111111;  // Grupp B (+e +w)

  group_a(0);         // address-group A bits to zero
  group_b(0);         // address-group B bits to zero

  init_buf(0x0);       // all to zero
  
  delay(500);
}


void loop() {

  button();

  init_buf(z);         // cycle demo
  write_buf();
 
  delay(20);

  read_buf();

  group_a(0);  
  group_b(0); 
  
  print_buf();
  
  init_buf(0x0);       // all to zero 0

  z++;
  if (z > 15) {
    z = 0;
  }
  
  delay(300);
}


uint8_t r(uint8_t m, uint8_t n) {  // a ja b vs m ja n

  PORTD |= 0x10 | 0x20; // e ja w high
  
  nano_delay(TAVEL);    // address setup time
  
  PORTB |= n;           // grupp B + e + w 
  PORTD = m << 2;       // grupp A. first bits reserverd Rx ja Tx 

  nano_delay(TEHEL);    // E up time
  PORTB ^= 0x10;        // toggle e --> low
  
  nano_delay(TELAX);
  return PINC;          // read data
}

// case 2.
void w(uint8_t m, uint8_t n, uint8_t o) {
    
  PORTD |= 0x10 | 0x20; // e ja w high

  nano_delay(TAVEL);    // address setup time
  
  PORTB |= n;           // grupp B + e + w 
  PORTD = m << 2;       // grupp A + 

  nano_delay(TEHEL);    // E up time
  PORTB ^= 0x10;        // toggle e --> low
  PORTB ^= 0x20;        // toggle w --> low

  nano_delay(TWLEL);
  
  PORTC = o;
  nano_delay(TDVWH);
}


// 16MHz: 1 period = 62.5 ns
void nano_delay(uint8_t z) {
  uint8_t j = (1 * z / 62) + 1; 
  for (uint8_t i = 0; i < j; i++) {
    ;
  }
}


// init test data in array
void init_buf(uint8_t n) {
  for (uint8_t j = 0; j < 16; j++) { 
    for (uint8_t i = 0; i < 64; i++) {
      if (n == 99) {
        s[j][i] = j;
      }
      else {
        s[j][i] = n;
      }
    }   
  }
}


void write_buf(void) {
  for (uint8_t b = 0; b < 16; b++) { 
    for (uint8_t a = 0; a < 64; a++) { 
      w(a,b, s[b][a]);
    }
  }
}


void read_buf(void) {
  for (uint8_t b = 0; b < 16; b++) { 
    for (uint8_t a = 0; a < 64; a++) { 
      s[b][a] = r(a,b);
    }
  }
}


void print_buf(void) {

  for (uint8_t j = 0; j < 16; j++) {
    for (uint8_t i = 0; i < 64; i++) {

      if (i == 0 && j == 0) {
        Serial.println(F("uint8_t s[][64]={"));
      }
      
      if (i == 0) {
        Serial.print("{");
      }
      
      Serial.print("0x"); 
      Serial.print(s[j][i], HEX);
      
      if (i < 63) {
        Serial.print(",");
      }
      else {
        Serial.print("}");
        if (j < 15) {
          Serial.print(",");  
        }
        else {
          Serial.println();
          Serial.println("};");
        }
      }      
    }
    Serial.println();
  }
}


// group with 6 bits
void group_a(uint8_t i) {
  if (i == 0) {
    PORTD = B00000000;  
  }
  else {
    PORTD = B11111100;  // 0, 1 on rx, tx
  }  
}

// group with 4 bits
void group_b(uint8_t i) {
  if (i == 0) {
    PORTB = B00000000;  
  }
  else {
    PORTB = B00001111;  // 4, 5 on e, w
  }  
}

// control with push-button
void button() {

  bool newState = digitalRead(BUTTON_PIN); 

  if (newState == LOW && oldState == HIGH) {
    delay(20);
    newState = digitalRead(BUTTON_PIN);
  }
  
  oldState = newState;
}
